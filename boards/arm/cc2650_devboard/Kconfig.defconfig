## boards/arm/cc2650_devboard/Kconfig.defconfig
```kconfig
# TI CC2650 Devboard

# Copyright (c) 2019 Brett Witherspoon
# SPDX-License-Identifier: Apache-2.0

if BOARD_CC2650_DEVBOARD

config BOARD
	default "cc2650_devboard"

endif # BOARD_CC2650_DEVBOARD
```

## boards/arm/cc2650_devboard/cc2650_devboard_defconfig
```kconfig
#
# Copyright (c) 2019 Brett Witherspoon
#
# SPDX-License-Identifier: Apache-2.0
#

CONFIG_SOC_SERIES_CC2650=y
CONFIG_SOC_CC2650=y
CONFIG_BOARD_CC2650_DEVBOARD=y
CONFIG_BUILD_OUTPUT_HEX=y

CONFIG_CC2650_BOOTLOADER_ENABLE=y
CONFIG_CC2650_BOOTLOADER_BACKDOOR_ENABLE=y
CONFIG_CC2650_BOOTLOADER_BACKDOOR_PIN=13

# Enable MPU and hardware stack protection
CONFIG_ARM_MPU=n
CONFIG_HW_STACK_PROTECTION=n

CONFIG_PINCTRL=n
CONFIG_GPIO=y
CONFIG_SERIAL=n

CONFIG_CONSOLE=n
CONFIG_UART_CONSOLE=n
```

## boards/arm/cherry_mote/Kconfig.board
```kconfig
# TI CC26x2R1 LaunchXL board

# Copyright (c) 2019 Brett Witherspoon
# SPDX-License-Identifier: Apache-2.0

config BOARD_CHERRY_MOTE
	bool "CherryMote from 1KT project"
	depends on SOC_CC2650
```

## boards/arm/cherry_mote/Kconfig.defconfig
```kconfig
# TI CC2650 Devboard

# Copyright (c) 2019 Brett Witherspoon
# SPDX-License-Identifier: Apache-2.0

if BOARD_CHERRY_MOTE

config BOARD
	default "cherry_mote"

endif # BOARD_CHERRY_MOTE
```

## boards/ti/cc2650_devboard/Kconfig.board
```kconfig
# TI CC26x2R1 LaunchXL board

# Copyright (c) 2019 Brett Witherspoon
# SPDX-License-Identifier: Apache-2.0

config BOARD_CC2650_DEVBOARD
	bool "TI CC2650 Devboard"
	depends on SOC_CC2650
```

## boards/ti/cherry_mote/Kconfig.cherry_mote
```kconfig
# TI CC26x2R1 LaunchXL board

# Copyright (c) 2019 Brett Witherspoon
# SPDX-License-Identifier: Apache-2.0

config BOARD_CHERRY_MOTE
	select SOC_CC2650
```

## boards/ti/cherry_mote/cherry_mote_defconfig
```kconfig
#
# Copyright (c) 2019 Brett Witherspoon
#
# SPDX-License-Identifier: Apache-2.0
#

CONFIG_BUILD_OUTPUT_HEX=y

CONFIG_CC2650_BOOTLOADER_ENABLE=y
CONFIG_CC2650_BOOTLOADER_BACKDOOR_ENABLE=y
CONFIG_CC2650_BOOTLOADER_BACKDOOR_PIN=11

# Enable MPU and hardware stack protection
CONFIG_ARM_MPU=n
CONFIG_HW_STACK_PROTECTION=n

CONFIG_PINCTRL=y
CONFIG_GPIO=y
CONFIG_SERIAL=y
CONFIG_UART_CC13XX_CC26XX=y
CONFIG_LOG_BUFFER_SIZE=4300

CONFIG_CONSOLE=y
CONFIG_UART_CONSOLE=y
CONFIG_UART_INTERRUPT_DRIVEN=y
CONFIG_PM=y

CONFIG_IEEE802154=y
```

## drivers/gpio/Kconfig.cc2650
```kconfig
# TI CC13xx / CC26xx GPIO configuration options

# Copyright (c) 2019 Brett Witherspoon
# SPDX-License-Identifier: Apache-2.0

config GPIO_CC2650
	bool "TI SimpleLink CC2650 GPIO driver"
	default n
	depends on DT_HAS_TI_CC2650_GPIO_ENABLED
	help
	  Enable the TI SimpleLink CC2650 GPIO driver.
```

## soc/ti/simplelink/cc2650/Kconfig.series
```kconfig
# Texas Instruments SimpleLink CC13x2 / CC26x2

# Copyright (c) 2019 Brett Witherspoon
# SPDX-License-Identifier: Apache-2.0

config SOC_SERIES_CC2650
	bool "TI SimpleLink Family CC2650"
	select ARM
	select CPU_CORTEX_M3
#	select CPU_HAS_ARM_MPU
	select DYNAMIC_INTERRUPTS
#	select CPU_CORTEX_M_HAS_DWT
#	select CPU_HAS_FPU
	select SOC_FAMILY_TISIMPLELINK
	select HAS_CC26X0_SDK
	select HAS_TI_CCFG if !BOOTLOADER_MCUBOOT
	select HAS_SEGGER_RTT if ZEPHYR_SEGGER_MODULE
	select HAS_PM
	select HAS_POWEROFF
	help
	  Enable support for TI SimpleLink CC2650 SoCs
```

## soc/ti/simplelink/cc2650/Kconfig.soc
```kconfig
# Texas Instruments SimpleLink CC13x2 / CC26x2

# Copyright (c) 2019 Brett Witherspoon
# SPDX-License-Identifier: Apache-2.0

config SOC_SERIES_CC2650
	bool
	select SOC_FAMILY_TI_SIMPLELINK
	help
	  Enable support for TI SimpleLink CC2650 SoCs

config SOC_CC2650
	bool
	select SOC_SERIES_CC2650
	help
	  CC2650

config SOC_SERIES
	default "cc2650" if SOC_SERIES_CC2650

config SOC
	default "cc2650" if SOC_CC2650
```
