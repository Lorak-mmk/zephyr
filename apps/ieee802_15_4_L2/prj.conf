## prj.conf
```kconfig
CONFIG_LOG_MODE_IMMEDIATE=y
CONFIG_UART_ASYNC_API=y
CONFIG_LOG_PRINTK=y
CONFIG_LOG_BACKEND_UART_ASYNC=y
#CONFIG_ASSERT=y
#CONFIG_BOOT_BANNER=n
#CONFIG_EARLY_CONSOLE=n

CONFIG_GPIO=y
CONFIG_SERIAL=y

CONFIG_NETWORKING=y

CONFIG_IEEE802154=y
CONFIG_NET_L2_IEEE802154=y

CONFIG_NET_PKT_RX_COUNT=3
CONFIG_NET_PKT_TX_COUNT=3
CONFIG_NET_BUF_RX_COUNT=3
CONFIG_NET_BUF_TX_COUNT=3
CONFIG_NET_BUF_DATA_SIZE=128

CONFIG_NET_CONFIG_SETTINGS=y
CONFIG_NET_CONFIG_AUTO_INIT=n
CONFIG_NET_LOG=y

CONFIG_TEST_RANDOM_GENERATOR=y
```

## src/main.c
```c
/*
 * Copyright (c) 2016-2019 Intel Corporation
 *
 * SPDX-License-Identifier: Apache-2.0
 */

/**
 * @file
 * @brief App implementing 802.15.4 "serial-radio" protocol
 *
 * Application implementing 802.15.4 "serial-radio" protocol compatible
 * with popular Contiki-based native border routers.
 */

#include <zephyr/logging/log.h>
LOG_MODULE_REGISTER(ieee802_15_4_tx, 5);

#include <zephyr/drivers/uart.h>
#include <zephyr/kernel.h>
#include <zephyr/random/random.h>

#include <zephyr/net_buf.h>
#include <zephyr/net/ieee802154_radio.h>


int main(void)
{
	LOG_INF("Starting ieee802.15.4 TX example application");

	struct net_if* l2 = net_if_get_ieee802154();



	LOG_DBG("DONE MAIN");

	return 0;
}
```
