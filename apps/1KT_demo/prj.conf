## CMakeLists.txt
```
# SPDX-License-Identifier: Apache-2.0

cmake_minimum_required(VERSION 3.20.0)
find_package(Zephyr REQUIRED HINTS $ENV{ZEPHYR_BASE})
project(ieee802_15_4_L2)

# target_include_directories(app PRIVATE ${ZEPHYR_BASE}/subsys/net/ip)

FILE(GLOB app_sources src/*.c)
target_sources(app PRIVATE ${app_sources})
```

## prj.conf
```kconfig
CONFIG_LOG_MODE_IMMEDIATE=y
CONFIG_UART_ASYNC_API=y
CONFIG_LOG_PRINTK=y
CONFIG_LOG_BACKEND_UART_ASYNC=y
CONFIG_LOG_BACKEND_UART=y

#CONFIG_ASSERT=y
#CONFIG_BOOT_BANNER=n
#CONFIG_EARLY_CONSOLE=n

CONFIG_SHELL=y
CONFIG_SHELL_LOG_BACKEND=n

CONFIG_NETWORKING=y

CONFIG_IEEE802154=y
CONFIG_IEEE802154_RAW_MODE=y

CONFIG_NET_PKT_RX_COUNT=3
CONFIG_NET_PKT_TX_COUNT=3
CONFIG_NET_BUF_RX_COUNT=3
CONFIG_NET_BUF_TX_COUNT=3
CONFIG_NET_BUF_DATA_SIZE=128

CONFIG_NET_CONFIG_SETTINGS=y
CONFIG_NET_CONFIG_AUTO_INIT=n
CONFIG_NET_LOG=y

CONFIG_TEST_RANDOM_GENERATOR=y
```

## src/main.c
```c
/*
 * Copyright (c) 2016-2019 Intel Corporation
 *
 * SPDX-License-Identifier: Apache-2.0
 */

/**
 * @file
 * @brief App implementing 802.15.4 "serial-radio" protocol
 *
 * Application implementing 802.15.4 "serial-radio" protocol compatible
 * with popular Contiki-based native border routers.
 */

#include <zephyr/logging/log.h>
LOG_MODULE_REGISTER(1KT_demo);

#include <zephyr/drivers/uart.h>
#include <zephyr/kernel.h>
#include <zephyr/random/random.h>

#include <zephyr/net_buf.h>
#include <zephyr/net/ieee802154_radio.h>

#include <zephyr/shell/shell.h>

static int cmd_uart_lite_start (const struct shell *sh, size_t argc, char **argv) {
	LOG_INF("Called uart lite start");
	shell_print(sh, "uart lite start argc = %zd", argc);
	for (size_t cnt = 0; cnt < argc; cnt++) {
		shell_print(sh, "  argv[%zd] = %s", cnt, argv[cnt]);
	}

	return 0;
}

static int cmd_uart_lite_stop (const struct shell *sh, size_t argc, char **argv) {
	LOG_INF("Called uart lite stop");
	shell_print(sh, "uart lite stop argc = %zd", argc);
	for (size_t cnt = 0; cnt < argc; cnt++) {
		shell_print(sh, "  argv[%zd] = %s", cnt, argv[cnt]);
	}

	return 0;
}


SHELL_STATIC_SUBCMD_SET_CREATE(sub_uart_lite,
	SHELL_CMD_ARG(start, NULL,
		  "Start sending UART Lite messages every X ms",
		  cmd_uart_lite_start, 2, 0),
	SHELL_CMD_ARG(stop, NULL,
		  "Start sending UART Lite messages every 1ms",
		  cmd_uart_lite_stop, 2, 0),
	SHELL_SUBCMD_SET_END /* Array terminated. */
);

SHELL_STATIC_SUBCMD_SET_CREATE(sub_demo,
	SHELL_CMD_ARG(lite, &sub_uart_lite, "UART Lite commands", NULL, 2, 0),
	SHELL_SUBCMD_SET_END /* Array terminated. */
);

SHELL_CMD_REGISTER(demo, &sub_demo, "Log test", NULL);


/* ieee802.15.4 device */
static struct ieee802154_radio_api *radio_api;
static const struct device *const ieee802154_dev =
	DEVICE_DT_GET(DT_CHOSEN(zephyr_ieee802154));

static void tx_thread()
{
	LOG_DBG("TX thread started");

	struct net_pkt *pkt;
	struct net_buf *buf;

	pkt = net_pkt_alloc_with_buffer(NULL, 256,
							AF_UNSPEC, 0,
							K_NO_WAIT);
	if (!pkt) {
		LOG_ERR("No more buffers");
		return;
	}

	buf = net_buf_frag_last(pkt->buffer);
	//*buf->data &= !IEEE802154_AR_FLAG_SET;
	net_buf_add_mem(buf, "abcdefgh12349876", 16);

	*buf->data &= ~IEEE802154_AR_FLAG_SET;

	LOG_DBG("tx thread pkt %p buf %p", pkt, buf);
	LOG_HEXDUMP_DBG(buf->data, buf->len, "DATA >");

	while (true) {
		LOG_DBG("calling tx!");
		int ret = radio_api->tx(ieee802154_dev, IEEE802154_TX_MODE_CSMA_CA,
					pkt, buf);
		if (ret) {
			LOG_ERR("Error transmit data: 0x%x", ret);
		} else {
			LOG_DBG("send packet!");
		}
		k_sleep(K_MSEC(3000));
		// net_pkt_unref(pkt);
	}
}


static bool init_ieee802154(void)
{
	LOG_INF("Initialize ieee802.15.4");

	if (!device_is_ready(ieee802154_dev)) {
		LOG_ERR("IEEE 802.15.4 device not ready");
		return false;
	}

	radio_api = (struct ieee802154_radio_api *)ieee802154_dev->api;


	LOG_INF("Set channel %u", 11);
	radio_api->set_channel(ieee802154_dev, 11);

	/* Start ieee802154 */
	radio_api->start(ieee802154_dev);

	return true;
}

int net_recv_data(struct net_if *iface, struct net_pkt *pkt)
{
 	LOG_DBG("Received pkt %p, len %d", pkt, net_pkt_get_len(pkt));
	struct net_buf *buf = net_buf_frag_last(pkt->buffer);
	LOG_DBG("pkt %p buf %p", pkt, buf);
	LOG_HEXDUMP_DBG(buf->data, buf->len, "DATA >");
	net_pkt_unref(pkt);
 	return 0;
}


int main(void)
{
	LOG_INF("Starting ieee802.15.4 TX example application");

	/* Initialize ieee802154 device */
	if (!init_ieee802154()) {
		LOG_ERR("Unable to initialize ieee802154");
		return 0;
	}

	/* Initialize RX thread */
	tx_thread();

	LOG_DBG("DONE MAIN");

	return 0;
}
```
