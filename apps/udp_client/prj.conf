## CMakeLists.txt
```
# SPDX-License-Identifier: Apache-2.0

cmake_minimum_required(VERSION 3.20.0)
find_package(Zephyr REQUIRED HINTS $ENV{ZEPHYR_BASE})
project(udp_client)

# target_include_directories(app PRIVATE ${ZEPHYR_BASE}/subsys/net/ip)

FILE(GLOB app_sources src/*.c)
target_sources(app PRIVATE ${app_sources})
```

## prj.conf
```kconfig
#CONFIG_LOG_MODE_IMMEDIATE=y
CONFIG_UART_ASYNC_API=y
CONFIG_LOG_PRINTK=y
CONFIG_LOG_BACKEND_UART_ASYNC=y
CONFIG_LOG_BACKEND_UART=y

#CONFIG_ASSERT=y
#CONFIG_BOOT_BANNER=n
#CONFIG_EARLY_CONSOLE=n

CONFIG_TEST_RANDOM_GENERATOR=y

CONFIG_SHELL=n
CONFIG_NET_L2_IEEE802154_SHELL=n
CONFIG_SHELL_LOG_BACKEND=n

CONFIG_NETWORKING=y
CONFIG_NET_UDP=y
CONFIG_NET_IPV4=y
CONFIG_NET_SOCKETS=y
CONFIG_NET_LOG=y
CONFIG_IEEE802154=y
CONFIG_NET_L2_IEEE802154=y
CONFIG_NET_L2_IEEE802154_LOG_LEVEL_INF=y
CONFIG_NET_CONFIG_IEEE802154_CHANNEL=11
#CONFIG_IEEE802154_DRIVER_LOG_LEVEL_DBG=y
# CONFIG_IEEE802154_RAW_MODE=y

CONFIG_NET_PKT_RX_COUNT=3
CONFIG_NET_PKT_TX_COUNT=3
CONFIG_NET_BUF_RX_COUNT=3
CONFIG_NET_BUF_TX_COUNT=3
CONFIG_NET_BUF_DATA_SIZE=96

CONFIG_NET_CONFIG_SETTINGS=y
CONFIG_NET_CONFIG_NEED_IPV4=y
CONFIG_NET_CONFIG_MY_IPV4_ADDR="192.0.2.2"
CONFIG_NET_CONFIG_PEER_IPV4_ADDR="192.0.2.1"
CONFIG_NET_CONTEXT_RCVTIMEO=y
```

## src/main.c
```c
#include <zephyr/logging/log.h>
LOG_MODULE_REGISTER(udp_client, LOG_LEVEL_DBG);

#include <zephyr/drivers/uart.h>
#include <zephyr/kernel.h>
#include <zephyr/net/socket.h>

#include <zephyr/shell/shell.h>

#define LISTEN_PORT 4242
#define TEMP_TRANSFER_INTERVAL_SECS 5

struct TemperatureMeasurementMsg {
    uint32_t cherry_mote_id;
    uint32_t sequential_no;
    uint32_t timestamp;
    int32_t temperature_centigrades_celsius;
};


void send_requests(int socket) {
	struct sockaddr_in server_addr;
	socklen_t server_addr_length = sizeof(server_addr);

	char buffer[24] = {0};
	while (true) {
		k_msleep(3000);
		server_addr.sin_family = AF_INET;
		server_addr.sin_port = htons(LISTEN_PORT);
		zsock_inet_pton(AF_INET, CONFIG_NET_CONFIG_PEER_IPV4_ADDR,
			  &server_addr.sin_addr);
		LOG_INF("Sending request");
		int ret = zsock_sendto(socket, &buffer, sizeof(buffer), 0, (struct sockaddr *)&server_addr, server_addr_length);
		if (ret < 0) {
			LOG_ERR("sendto failed (%d)", ret);
			continue;
		}

		LOG_INF("Waiting for response");
		ssize_t received_bytes = zsock_recvfrom(socket, &buffer, sizeof(buffer), 0, (struct sockaddr *)&server_addr, &server_addr_length);
		if (received_bytes < 0) {
			LOG_ERR("Could not receive data from socket: %d", received_bytes);
			continue;
		}
		if (received_bytes != sizeof(struct TemperatureMeasurementMsg)) {
			LOG_ERR("Received message has wrong size: %d", received_bytes);
			continue;
		}
		struct TemperatureMeasurementMsg *message = (struct TemperatureMeasurementMsg *)buffer;
		LOG_INF("Received temperature measurement. CherryMote id: %u, seq: %u, timestamp: %u, temp: %d",
			message->cherry_mote_id,
			message->sequential_no,
			message->timestamp,
			message->temperature_centigrades_celsius);
	}
}

int main(void)
{
	LOG_INF("Starting udp temperature server interop demo");

	int socket = zsock_socket(AF_INET, SOCK_DGRAM, IPPROTO_UDP);
	if (socket < 0) {
		LOG_ERR("Can't create socket %d\n", socket);
		return 0;
	}

	struct timeval tv;
	tv.tv_sec = 0;
	tv.tv_usec = 100000;

	int ret = zsock_setsockopt(socket, SOL_SOCKET, SO_RCVTIMEO, &tv,sizeof(tv));
	if (ret != 0) {
		LOG_ERR("Can't set socket timeout %d\n", ret);
		return 0;
	}

	send_requests(socket);

	return 0;
}
```
