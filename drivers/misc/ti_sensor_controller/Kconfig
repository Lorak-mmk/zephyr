## drivers/misc/ti_sensor_controller/Kconfig
```kconfig
# Copyright (c) 2023 TOKITA Hiroshi <tokita.hiroshi@fujitsu.com>
# SPDX-License-Identifier: Apache-2.0

config TI_SENSOR_CONTROLLER
	bool "TI Sensor Controller"
	default y
	depends on DT_HAS_TI_SENSOR_CONTROLLER_ENABLED
```

## drivers/sensor/ti/tmp431/Kconfig
```kconfig
# TMP431 temperature sensor configuration options

# Copyright (c) 2016 Firmwave
# SPDX-License-Identifier: Apache-2.0

config TMP431
	bool "TMP431 Temperature Sensor"
	default y
	depends on DT_HAS_TI_TMP431_ENABLED
	select I2C
	help
	  Enable the driver for Texas Instruments TMP431 Temperature Sensors.

if TMP431

config TMP431_FULL_SCALE_RUNTIME
	bool "Allow to set extended mode at runtime"
	default y
	help
	  When set extended mode can be selected using tmp431_attr_set
	  with SENSOR_ATTR_FULL_SCALE and value to set either 127 or 191

config TMP431_SAMPLING_FREQUENCY_RUNTIME
	bool "Allow to set conversion rate at runtime"
	default y
	help
	  When set conversion rate can be set at runtime using sensor_attr_set
	  with SENSOR_ATTR_SAMPLING_FREQUENCY

endif # TMP431
```

## drivers/serial/uart_lite_cc13xx_cc26xx/Kconfig
```kconfig
config UART_LITE_CC13XX_CC26XX
	bool "TI SimpleLink CC13xx / CC26xx UART emulated using Sensor Controller"
	default y
	depends on DT_HAS_TI_CC13XX_CC26XX_UART_LITE_ENABLED
	select SERIAL_HAS_DRIVER
	select SERIAL_SUPPORT_ASYNC
	select CONFIG_DYNAMIC_INTERRUPTS
	help
	  Enable the TI SimpleLink CC13xx / CC26xx UART Lite driver.
```

## dts/bindings/misc/ti,sensor-controller.yaml
```yaml
# Copyright (c) 2022 Nordic Semiconductor ASA
# SPDX-License-Identifier: Apache-2.0

description: TI SimpleLink CC13xx / CC26xx Sensor Controller

compatible: "ti,sensor-controller"

include: base.yaml
```

## dts/bindings/sensor/ti,tmp431.yaml
```yaml
# Copyright (c) 2019, Linaro Limited
# SPDX-License-Identifier: Apache-2.0

description: |
    TMP431 Temperature Sensor. See more info at
    https://www.ti.com/product/TMP431

compatible: "ti,tmp431"

include: [sensor-device.yaml, i2c-device.yaml]

properties:
  extended-mode:
    description: If enabled, uses temperature range from [-64°C, 191°C]. If disabled, uses [0°C, 127°C]. 
    type: boolean
  supply-pin:
    type: phandles
    description: Pin that powers on the thermometer
  conversion-rate:
    description: Conversion rate in tenths of mHz (milli-Hertz). 10000 = 1Hz
    type: int
    default: 40000
    enum:
      - 625
      - 1250
      - 2500
      - 5000
      - 10000
      - 20000
      - 40000
      - 80000
```

## dts/bindings/serial/ti,cc13xx-cc26xx-uart-lite.yaml
```yaml
# Copyright (c) 2019 Brett Witherspoon
# SPDX-License-Identifier: Apache-2.0

description: TI SimpleLink CC13xx / CC26xx UART Lite using Sensor Controller

compatible: "ti,cc13xx-cc26xx-uart-lite"

include: [uart-controller.yaml, pinctrl-device.yaml, base.yaml]

# properties:
#   interrupts:
#     required: true
```
